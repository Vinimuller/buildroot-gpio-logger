## package/gpio-logger/Config.in
```kconfig
config BR2_PACKAGE_GPIO_LOGGER
    bool "gpio-logger"
    select BR2_PACKAGE_LIBGPIOD
    help
      Logs GPIO events with edge detection and debounce.
```
